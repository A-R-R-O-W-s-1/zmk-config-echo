## config/boards/shields/echo/Kconfig.defconfig
```kconfig
if SHIELD_ECHO_LEFT

config ZMK_KEYBOARD_NAME
    default "echo"

config ZMK_SPLIT_ROLE_CENTRAL
    default y

endif

if SHIELD_ECHO_LEFT || SHIELD_ECHO_RIGHT

config ZMK_SPLIT
    default y

endif
```

## config/echo/Kconfig.shield
```kconfig
config SHIELD_ECHO_LEFT
    def_bool $(shields_list_contains,echo_left)

config SHIELD_ECHO_RIGHT
    def_bool $(shields_list_contains,echo_right)
```
