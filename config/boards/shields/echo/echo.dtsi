#include <zmk-node-labels.dtsi>

/ {
    chosen {
        zmk,kscan = &kscan0;
        zmk,physical-layout = &layout; // Use the physical layout
    };

    layout: layout {
        compatible = "zmk,physical-layout";
        // Assuming 19mm x 19mm key spacing, units are in um/10
        // Tweak these x/y values if the visual representation in Studio is off
        key-size = <1800 1800>;

        keys = <
        // Left Hand
        key_0_0(0,0)      key_0_1(1900,0)    key_0_2(3800,0)    key_0_3(5700,0)    key_0_4(7600,0)    key_0_5(9500,0)
        key_1_0(238,1900)   key_1_1(2138,1900) key_1_2(4038,1900) key_1_3(5938,1900) key_1_4(7838,1900) key_1_5(9738,1900)
        key_2_0(475,3800)   key_2_1(2375,3800) key_2_2(4275,3800) key_2_3(6175,3800) key_2_4(8075,3800) key_2_5(9975,3800)
        key_3_0(950,5700)   key_3_1(2850,5700) key_3_2(4750,5700) key_3_3(6650,5700) key_3_4(8550,5700) key_3_5(10450,5700)
                                                                                  key_4_4(8075,7600) key_4_5(9975,7600)
        // Right Hand (with a 4-unit gap between halves)
        key_0_6(15200,0)    key_0_7(17100,0)   key_0_8(19000,0)   key_0_9(20900,0)   key_0_10(22800,0)  key_0_11(24700,0)
        key_1_6(15438,1900) key_1_7(17338,1900) key_1_8(19238,1900) key_1_9(21138,1900) key_1_10(23038,1900) key_1_11(24938,1900)
        key_2_6(15675,3800) key_2_7(17575,3800) key_2_8(19475,3800) key_2_9(21375,3800) key_2_10(23275,3800) key_2_11(25175,3800)
        key_3_6(16150,5700) key_3_7(18050,5700) key_3_8(19950,5700) key_3_9(21850,5700) key_3_10(23750,5700) key_3_11(25650,5700)
        key_4_6(15675,7600) key_4_7(17575,7600)
        >;
    };

    kscan0: kscan {
        compatible = "zmk,kscan-gpio-matrix";
        wakeup-source;
        diode-direction = "col2row";
        row-gpios
            = <&pro_micro 0 (GPIO_ACTIVE_HIGH | GPIO_PULL_DOWN)>
            , <&pro_micro 1 (GPIO_ACTIVE_HIGH | GPIO_PULL_DOWN)>
            , <&pro_micro 10 (GPIO_ACTIVE_HIGH | GPIO_PULL_DOWN)>
            , <&pro_micro 16 (GPIO_ACTIVE_HIGH | GPIO_PULL_DOWN)>
            , <&pro_micro 2 (GPIO_ACTIVE_HIGH | GPIO_PULL_DOWN)>
            ;
    };
};